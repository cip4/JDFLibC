USER_OBJS      = \
                     $(CMPO_OBJ_DIR)$(DIRSEP)JDFDate.obj \
                     $(CMPO_OBJ_DIR)$(DIRSEP)JDFDateTimeRange.obj \
                     $(CMPO_OBJ_DIR)$(DIRSEP)JDFDateTimeRangeList.obj \
                     $(CMPO_OBJ_DIR)$(DIRSEP)JDFDuration.obj \
                     $(CMPO_OBJ_DIR)$(DIRSEP)JDFDurationRange.obj \
                     $(CMPO_OBJ_DIR)$(DIRSEP)JDFDurationRangeList.obj \
                     $(CMPO_OBJ_DIR)$(DIRSEP)JDFIntegerRange.obj \
                     $(CMPO_OBJ_DIR)$(DIRSEP)JDFIntegerRangeList.obj \
                     $(CMPO_OBJ_DIR)$(DIRSEP)JDFNameRange.obj \
                     $(CMPO_OBJ_DIR)$(DIRSEP)JDFNameRangeList.obj \
                     $(CMPO_OBJ_DIR)$(DIRSEP)JDFNumberRangeList.obj \
                     $(CMPO_OBJ_DIR)$(DIRSEP)JDFNumTypeList.obj \
                     $(CMPO_OBJ_DIR)$(DIRSEP)JDFParser.obj \
                     $(CMPO_OBJ_DIR)$(DIRSEP)JDFRange.obj \
                     $(CMPO_OBJ_DIR)$(DIRSEP)JDFRangeList.obj \
                     $(CMPO_OBJ_DIR)$(DIRSEP)JDFXYPairRangeList.obj \
                     $(CMPO_OBJ_DIR)$(DIRSEP)KElement.obj \
                     $(CMPO_OBJ_DIR)$(DIRSEP)KElementStrings.obj \
                     $(CMPO_OBJ_DIR)$(DIRSEP)MyDate.obj \
                     $(CMPO_OBJ_DIR)$(DIRSEP)vElement.obj \
                     $(CMPO_OBJ_DIR)$(DIRSEP)XMLDoc.obj \
                     $(CMPO_OBJ_DIR)$(DIRSEP)XMLDocUserData.obj