USER_OBJS      = \
                     $(CMPO_OBJ_DIR)$(DIRSEP)AuthenticationInfo.obj \
                     $(CMPO_OBJ_DIR)$(DIRSEP)Authenticator.obj \
                     $(CMPO_OBJ_DIR)$(DIRSEP)AutoPtr.obj \
                     $(CMPO_OBJ_DIR)$(DIRSEP)BASE64Decoder.obj \
                     $(CMPO_OBJ_DIR)$(DIRSEP)BASE64Encoder.obj \
                     $(CMPO_OBJ_DIR)$(DIRSEP)BasicAuthentication.obj \
                     $(CMPO_OBJ_DIR)$(DIRSEP)BoolJanitor.obj \
                     $(CMPO_OBJ_DIR)$(DIRSEP)BufferedInputStream.obj \
                     $(CMPO_OBJ_DIR)$(DIRSEP)BufferedOutputStream.obj \
                     $(CMPO_OBJ_DIR)$(DIRSEP)ByteArrayInputStream.obj \
                     $(CMPO_OBJ_DIR)$(DIRSEP)ByteArrayOutputStream.obj \
                     $(CMPO_OBJ_DIR)$(DIRSEP)ByteBuffer.obj \
                     $(CMPO_OBJ_DIR)$(DIRSEP)CharacterDecoder.obj \
                     $(CMPO_OBJ_DIR)$(DIRSEP)CharacterEncoder.obj \
                     $(CMPO_OBJ_DIR)$(DIRSEP)CharBuffer.obj \
                     $(CMPO_OBJ_DIR)$(DIRSEP)ChunkedInputStream.obj \
                     $(CMPO_OBJ_DIR)$(DIRSEP)CidURLStreamHandler.obj \
                     $(CMPO_OBJ_DIR)$(DIRSEP)DigestAuthentication.obj \
                     $(CMPO_OBJ_DIR)$(DIRSEP)dtoa.obj \
                     $(CMPO_OBJ_DIR)$(DIRSEP)File.obj \
                     $(CMPO_OBJ_DIR)$(DIRSEP)FileInputStream.obj \
                     $(CMPO_OBJ_DIR)$(DIRSEP)FileMIMEType.obj \
                     $(CMPO_OBJ_DIR)$(DIRSEP)FileOutputStream.obj \
                     $(CMPO_OBJ_DIR)$(DIRSEP)FileSystem.obj \
                     $(CMPO_OBJ_DIR)$(DIRSEP)FileURLConnection.obj \
                     $(CMPO_OBJ_DIR)$(DIRSEP)FileURLStreamHandler.obj \
                     $(CMPO_OBJ_DIR)$(DIRSEP)FilterInputStream.obj \
                     $(CMPO_OBJ_DIR)$(DIRSEP)FilterOutputStream.obj \
                     $(CMPO_OBJ_DIR)$(DIRSEP)HeaderParser.obj \
                     $(CMPO_OBJ_DIR)$(DIRSEP)HttpClient.obj \
                     $(CMPO_OBJ_DIR)$(DIRSEP)HttpsClient.obj \
                     $(CMPO_OBJ_DIR)$(DIRSEP)HttpsURLStreamHandler.obj \
                     $(CMPO_OBJ_DIR)$(DIRSEP)HttpURLConnection.obj \
                     $(CMPO_OBJ_DIR)$(DIRSEP)HttpURLStreamHandler.obj \
                     $(CMPO_OBJ_DIR)$(DIRSEP)InetAddress.obj \
                     $(CMPO_OBJ_DIR)$(DIRSEP)InetAddressCachePolicy.obj \
                     $(CMPO_OBJ_DIR)$(DIRSEP)InetAddressImpl.obj \
                     $(CMPO_OBJ_DIR)$(DIRSEP)InputStream.obj \
                     $(CMPO_OBJ_DIR)$(DIRSEP)Integer.obj \
                     $(CMPO_OBJ_DIR)$(DIRSEP)Integer64.obj \
                     $(CMPO_OBJ_DIR)$(DIRSEP)KeepAliveCache.obj \
                     $(CMPO_OBJ_DIR)$(DIRSEP)KeepAliveInputStream.obj \
                     $(CMPO_OBJ_DIR)$(DIRSEP)mapWString.obj \
                     $(CMPO_OBJ_DIR)$(DIRSEP)md5.obj \
                     $(CMPO_OBJ_DIR)$(DIRSEP)MessageHeader.obj \
                     $(CMPO_OBJ_DIR)$(DIRSEP)MeteredInputStream.obj \
                     $(CMPO_OBJ_DIR)$(DIRSEP)MIMEBasicPart.obj \
                     $(CMPO_OBJ_DIR)$(DIRSEP)MIMEBodyPart.obj \
                     $(CMPO_OBJ_DIR)$(DIRSEP)MIMEHeader.obj \
                     $(CMPO_OBJ_DIR)$(DIRSEP)MIMELocalResource.obj \
                     $(CMPO_OBJ_DIR)$(DIRSEP)MIMELocalResourceFactory.obj \
                     $(CMPO_OBJ_DIR)$(DIRSEP)MIMEMemResource.obj \
                     $(CMPO_OBJ_DIR)$(DIRSEP)MIMEMemResourceFactory.obj \
                     $(CMPO_OBJ_DIR)$(DIRSEP)MIMEMessage.obj \
                     $(CMPO_OBJ_DIR)$(DIRSEP)MIMEMessagePart.obj \
                     $(CMPO_OBJ_DIR)$(DIRSEP)MIMEMultiPart.obj \
                     $(CMPO_OBJ_DIR)$(DIRSEP)MIMEParser.obj \
                     $(CMPO_OBJ_DIR)$(DIRSEP)MimeTableFileNameMap.obj \
                     $(CMPO_OBJ_DIR)$(DIRSEP)Mutex.obj \
                     $(CMPO_OBJ_DIR)$(DIRSEP)myuti.obj \
                     $(CMPO_OBJ_DIR)$(DIRSEP)NetworkClient.obj \
                     $(CMPO_OBJ_DIR)$(DIRSEP)OutputStream.obj \
                     $(CMPO_OBJ_DIR)$(DIRSEP)ParseUtil.obj \
                     $(CMPO_OBJ_DIR)$(DIRSEP)PlainHttpOutputStream.obj \
                     $(CMPO_OBJ_DIR)$(DIRSEP)PlainHttpsURLConnection.obj \
                     $(CMPO_OBJ_DIR)$(DIRSEP)PlainHttpURLConnection.obj \
                     $(CMPO_OBJ_DIR)$(DIRSEP)PlainURLStreamHandlerFactory.obj \
                     $(CMPO_OBJ_DIR)$(DIRSEP)PlatformUtils.obj \
                     $(CMPO_OBJ_DIR)$(DIRSEP)PrintStream.obj \
                     $(CMPO_OBJ_DIR)$(DIRSEP)PushbackInputStream.obj \
                     $(CMPO_OBJ_DIR)$(DIRSEP)QPDecoder.obj \
                     $(CMPO_OBJ_DIR)$(DIRSEP)QPEncoder.obj \
                     $(CMPO_OBJ_DIR)$(DIRSEP)Random.obj \
                     $(CMPO_OBJ_DIR)$(DIRSEP)RandomAccessInputStream.obj \
                     $(CMPO_OBJ_DIR)$(DIRSEP)RandomAccessOutputStream.obj \
                     $(CMPO_OBJ_DIR)$(DIRSEP)Regexp.obj \
                     $(CMPO_OBJ_DIR)$(DIRSEP)RegexpPool.obj \
                     $(CMPO_OBJ_DIR)$(DIRSEP)ServerSocket.obj \
                     $(CMPO_OBJ_DIR)$(DIRSEP)Socket.obj \
                     $(CMPO_OBJ_DIR)$(DIRSEP)SetWString.obj \
                     $(CMPO_OBJ_DIR)$(DIRSEP)SocketImpl.obj \
                     $(CMPO_OBJ_DIR)$(DIRSEP)SocketOptions.obj \
                     $(CMPO_OBJ_DIR)$(DIRSEP)SSLSocket.obj \
                     $(CMPO_OBJ_DIR)$(DIRSEP)SSLSocketInputStream.obj \
                     $(CMPO_OBJ_DIR)$(DIRSEP)SSLSocketOutputStream.obj \
                     $(CMPO_OBJ_DIR)$(DIRSEP)StreamBuffer.obj \
                     $(CMPO_OBJ_DIR)$(DIRSEP)StringTokenizer.obj \
                     $(CMPO_OBJ_DIR)$(DIRSEP)Synchronized.obj \
                     $(CMPO_OBJ_DIR)$(DIRSEP)Throwable.obj \
                     $(CMPO_OBJ_DIR)$(DIRSEP)Unicode.obj \
                     $(CMPO_OBJ_DIR)$(DIRSEP)URI.obj \
                     $(CMPO_OBJ_DIR)$(DIRSEP)URL.obj \
                     $(CMPO_OBJ_DIR)$(DIRSEP)URLConnection.obj \
                     $(CMPO_OBJ_DIR)$(DIRSEP)URLDecoder.obj \
                     $(CMPO_OBJ_DIR)$(DIRSEP)URLEncoder.obj \
                     $(CMPO_OBJ_DIR)$(DIRSEP)URLStreamHandler.obj \
                     $(CMPO_OBJ_DIR)$(DIRSEP)vdouble.obj \
                     $(CMPO_OBJ_DIR)$(DIRSEP)vint.obj \
                     $(CMPO_OBJ_DIR)$(DIRSEP)vMapWString.obj \
                     $(CMPO_OBJ_DIR)$(DIRSEP)VoidSet.obj \
                     $(CMPO_OBJ_DIR)$(DIRSEP)vWString.obj \
                     $(CMPO_OBJ_DIR)$(DIRSEP)Win32FileSystem.obj \
                     $(CMPO_OBJ_DIR)$(DIRSEP)Win32InetAddressImpl.obj \
                     $(CMPO_OBJ_DIR)$(DIRSEP)Win32PlatformUtils.obj \
                     $(CMPO_OBJ_DIR)$(DIRSEP)Win32ProcessInputStream.obj \
                     $(CMPO_OBJ_DIR)$(DIRSEP)Win32ProcessOutputStream.obj \
                     $(CMPO_OBJ_DIR)$(DIRSEP)Win32Shortcut.obj \
                     $(CMPO_OBJ_DIR)$(DIRSEP)Win32SocketFactoryService.obj \
                     $(CMPO_OBJ_DIR)$(DIRSEP)Win32SocketImpl.obj \
                     $(CMPO_OBJ_DIR)$(DIRSEP)Win32SocketImplFactory.obj \
                     $(CMPO_OBJ_DIR)$(DIRSEP)Win32SocketImplInputStream.obj \
                     $(CMPO_OBJ_DIR)$(DIRSEP)Win32SocketImplOutputStream.obj \
                     $(CMPO_OBJ_DIR)$(DIRSEP)Win32SocketInit.obj \
                     $(CMPO_OBJ_DIR)$(DIRSEP)WString.obj \
                     $(CMPO_OBJ_DIR)$(DIRSEP)WWWURLConnection.obj
